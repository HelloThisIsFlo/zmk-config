## config/west.yml
```yaml
manifest:
  remotes:
    - name: zmkfirmware
      url-base: https://github.com/zmkfirmware
    - name: hellothisisflo
      url-base: https://github.com/HelloThisIsFlo
  projects:
    - name: zmk
      remote: hellothisisflo
      revision: main
      import: app/west.yml
  self:
    path: config
```
