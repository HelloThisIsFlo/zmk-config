                l_alpha_linwin {
                        label = "rEALITY¿"; // Windows layer, everything is upside down ⁉️
                        bindings = <
________      ________     ________     ________        ________                        ________    ________      ________    ________    ________
________      ________     ________     ________        ________                        ________    ________      ________    ________    ________
________      ________     ________     ________        ________                        ________    ________      ________    ________    ________
                                ________    ________    nav_akR_linwin         &blt l_nav_linwin SPACE     ________     ________
                        >;
                };