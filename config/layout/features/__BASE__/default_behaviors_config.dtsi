/****************************************************/
/****             Behavior Config                ****/
/****************************************************/
&caps_word {
    continue-list = <UNDER MINUS BSPC DEL LEFT RIGHT APOS>;
};

&sk {
    release-after-ms = <sticky_key_release_timeout>;
    quick-release;
};

// // Not used at the moment
// &sl {
//     release-after-ms = <sticky_key_release_timeout>;
//     // &sl are 'quick-release' by default
// };