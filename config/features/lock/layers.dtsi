        Lock {
            bindings = <
&none   &none   &none   &none   &none              &none   &none   &none   &none   &none
&none   &none   &none   &none   &none              &none   &none   &none   &none   &none
&none   &none   &none   &none   &none              &none   &none   &none   &none   &none
                    &none   &none   &none      &none   &none   &none
            >;

            label = "XXXX"; // Pin code
        };