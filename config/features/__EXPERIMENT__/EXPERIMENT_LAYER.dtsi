l_experiment {
  label = "EXPERIMENT";
  bindings = <

________      ________   ________   ________       ________                 ________   ________   ________   ________   ________
________      &aB        &aB_cD     hml_LSHIFT_T   ________                 ________   ________   ________   ________   ________
&bootloader   ________   &bsk LSHIFT   &kp LSHIFT     ________                 ________   ________   ________   ________   ________
                          ________   ________   ________         ________   ________   ________

  >;
};
