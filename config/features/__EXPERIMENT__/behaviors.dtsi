
// TMP Experiment
// TODO: Make macro
// TODO: Trigger sticky shift as well, after dot
// TODO: Build complex keys with mod-morph. Like: lk_DOT_SPACE, but then lk_SEMI_SPACE when shifted. Also same on combos for '!' or '?'.
ZMK_MACRO(type_dot_space, wait-ms = <10>; tap-ms = <10>; bindings = <&kp DOT>, <&kp SPACE>, <&skL LSHIFT>;)
lk_DOT_SPACE: lk_DOT_SPACE {
    compatible = "zmk,behavior-hold-tap";
    label = "lk_DOT_SPACE";
    #binding-cells = <2>;
    tapping-term-ms = <linger_term>;
    flavor = "tap-preferred";
    bindings = <&bk>, <&type_dot_space>;
};

aB_cD: aB_cD {
    compatible = "zmk,behavior-mod-morph";
    label = "aB_cD";
    #binding-cells = <0>;
    bindings = <&lk C A>, <&lk D B>;
    mods = <(MOD_LSFT|MOD_RSFT)>;
};

aB: aB {
    compatible = "zmk,behavior-mod-morph";
    label = "aB";
    #binding-cells = <0>;
    bindings = <&kp A>, <&kp B>;
    mods = <(MOD_LSFT|MOD_RSFT)>;
};


// lk_qu: lk_qu {
//     compatible = "zmk,behavior-hold-tap";
//     label = "lk_qu";
//     #binding-cells = <2>;
//     tapping-term-ms = <linger_term>;
//     flavor = "tap-preferred";
//     bindings = <&bk>, <&Qu>;
// };
