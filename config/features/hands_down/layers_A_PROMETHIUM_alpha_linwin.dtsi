                l_alpha_linwin {
                        label = "rEALITY¿"; // Windows layer, everything is upside down ⁉️
                        bindings = <
________      ________     ________     ________        ________                        ________    ________      ________    ________    ________
________      ________     ________     ________        ________                        ________    ________      ________    ________    ________
________      ________     ________     ________        ________                        ________    ________      ________    ________    ________
                                ________    ________    &blt l_nav_linwin R      &blt l_nav_linwin SPACE     ________     ________
                        >;
                };