/*
Removed from keymap (for now ?)

&SlshStar
&DqtRbk
&HashDllr

*/

/*
Based on: Hands-Down Rhodium
*/
                l_alpha {
                        label = "Reality?"; // The base layer ... ?
                        bindings = <

// FIXME: Disabling smart sqtdqt, keeping just SQT until I tweak the timings (or decide to keep only SQT)
&bk SQT       ak_B         ak_H         ak_G            ak_K                             &SlashHash   dotcol        &DashEqual  ak_J        ak_X

// hml_LCTRL_C   hml_LALT_S   hml_LGUI_N   hml_LSHIFT_T    ak_K                          comsemi      hmr_LSHIFT_A  hmr_LGUI_E  &hmr LALT I &hmr LCTRL M

//                                                      FIXME: This is temporary, until I figure out what key I want to put here (then to a ?D_to_GD)
ak_C          ak_S         ak_N         ak_T            ak_G                             comsemi      ak_A          ak_E        &bk I    &bk M

ak_P          ak_F         ak_L         ak_D            ak_V                          &UnderStar      ak_U          ak_O        ak_Y        ak_W

                     // &mo l_num   &bk LSHIFT          &hrmSk LSHIFT R        &hrmSk RSHIFT SPACE  &bskL RSHIFT  &togMacPc


                     // - Removed the number layer mo from the right hand, as I was never using it.
                     // - Also removed sticky shift from the right hand, I think left hand is enough, but we'll see.
                        // &hrr l_mod l_mod &bsklt l_num LSHIFT  &blt l_nav R           &blt l_nav SPACE     &bsk RSHIFT     &togMacPc

                        // &kp SQT      tapStickyShiftHoldModsLayer     &blt l_nav R                 &blt l_numsym SPACE     &mo l_numsym     &togMacPc
                        &mo l_num tapStickyShiftHoldModsLayer     &blt l_nav R                 &blt l_numsym SPACE     &mo l_numsym     &togMacPc



                     // &mo l_num   &mo l_mod           &bksl l_nav R          &SpaceUnder  &skL RSHIFT  &togMacPc
                     // &mo l_mod  &bsklt l_num LSHIFT  &blt l_nav R           &SpaceUnder       &mo l_fn     &togMacPc
                        >;
                };
