/******************** Home Row Mods **********************/
hm: homerow_mods { // use on either hand
    compatible = "zmk,behavior-hold-tap";
    label = "homerow_mods";
    #binding-cells = <2>;
    tapping-term-ms = <my_tapping_term>;
    quick-tap-ms = <my_global_quick_tap_window>;
    global-quick-tap;
    flavor = "tap-preferred";
    bindings = <&kp>, <&bk>;
};

// TODO: Use Bsk here (after doing supporting 'hold' in bk and bsk macros). Actually maybe it doesn't matter, I don't think the out of order issue would be a problem with modifiers (but why not, let's make it consistent with the rest)
hrmSk: hrmSk {
    compatible = "zmk,behavior-hold-tap";
    label = "homerow_mods_sk";
    #binding-cells = <2>;
    tapping-term-ms = <my_tapping_term>;
    quick-tap-ms = <my_global_quick_tap_window>;
    global-quick-tap;
    flavor = "tap-preferred";
    bindings = <&sk>, <&bk>;
};

hml: homerow_mods_left { // use on left hand to mod right
    compatible = "zmk,behavior-hold-tap";
    label = "homerow_mods_left";
    #binding-cells = <2>;
    tapping-term-ms = <my_tapping_term>;
    quick-tap-ms = <my_global_quick_tap_window>;
    global-quick-tap;
    flavor = "tap-preferred";
    bindings = <&kp>, <&bk>;
};
ZMK_MACRO(ak_S_macro, wait-ms = <0>; tap-ms = <0>; bindings = <&ak l_akS S>;)
hml_S: hml_S {
    compatible = "zmk,behavior-hold-tap";
    label = "hml_S";
    #binding-cells = <2>;
    tapping-term-ms = <my_tapping_term>;
    quick-tap-ms = <my_global_quick_tap_window>;
    global-quick-tap;
    flavor = "tap-preferred";
    bindings = <&kp>, <&ak_S_macro>;
};
ZMK_MACRO(ak_C_macro, wait-ms = <0>; tap-ms = <0>; bindings = <&ak l_akC C>;)
hml_C: hml_C {
    compatible = "zmk,behavior-hold-tap";
    label = "hml_C";
    #binding-cells = <2>;
    tapping-term-ms = <my_tapping_term>;
    quick-tap-ms = <my_global_quick_tap_window>;
    global-quick-tap;
    flavor = "tap-preferred";
    bindings = <&kp>, <&ak_C_macro>;
};
ZMK_MACRO(ak_N_macro, wait-ms = <0>; tap-ms = <0>; bindings = <&ak l_akN N>;)
hml_N: hml_N {
    compatible = "zmk,behavior-hold-tap";
    label = "hml_N";
    #binding-cells = <2>;
    tapping-term-ms = <my_tapping_term>;
    quick-tap-ms = <my_global_quick_tap_window>;
    global-quick-tap;
    flavor = "tap-preferred";
    bindings = <&kp>, <&ak_N_macro>;
};
ZMK_MACRO(ak_T_macro, wait-ms = <0>; tap-ms = <0>; bindings = <&ak l_akT T>;)
hml_T: hml_T {
    compatible = "zmk,behavior-hold-tap";
    label = "hml_T";
    #binding-cells = <2>;
    tapping-term-ms = <my_tapping_term>;
    quick-tap-ms = <my_global_quick_tap_window>;
    global-quick-tap;
    flavor = "tap-preferred";
    bindings = <&sk>, <&ak_T_macro>;
};// TODO add macros for all these hml_X and make it clear that A and T and using &sk for the mod instead of &kp

hmr: homerow_mods_right { // use on right hand to mod left
    compatible = "zmk,behavior-hold-tap";
    label = "homerow_mods_right";
    #binding-cells = <2>;
    tapping-term-ms = <my_tapping_term>;
    quick-tap-ms = <my_global_quick_tap_window>;
    global-quick-tap;
    flavor = "tap-preferred";
    bindings = <&kp>, <&bk>;
};
ZMK_MACRO(ak_A_macro, wait-ms = <0>; tap-ms = <0>; bindings = <&ak l_akA A>;)
hmr_A: hmr_A {
    compatible = "zmk,behavior-hold-tap";
    label = "hmr_A";
    #binding-cells = <2>;
    tapping-term-ms = <my_tapping_term>;
    quick-tap-ms = <my_global_quick_tap_window>;
    global-quick-tap;
    flavor = "tap-preferred";
    bindings = <&sk>, <&ak_A_macro>;
};
ZMK_MACRO(ak_E_macro, wait-ms = <0>; tap-ms = <0>; bindings = <&ak l_akE E>;)
hmr_E: hmr_E {
    compatible = "zmk,behavior-hold-tap";
    label = "hmr_E";
    #binding-cells = <2>;
    tapping-term-ms = <my_tapping_term>;
    quick-tap-ms = <my_global_quick_tap_window>;
    global-quick-tap;
    flavor = "tap-preferred";
    bindings = <&kp>, <&ak_E_macro>;
};
ZMK_MACRO(ak_I_macro, wait-ms = <0>; tap-ms = <0>; bindings = <&ak l_akI I>;)
hmr_I: hmr_I {
    compatible = "zmk,behavior-hold-tap";
    label = "hmr_I";
    #binding-cells = <2>;
    tapping-term-ms = <my_tapping_term>;
    quick-tap-ms = <my_global_quick_tap_window>;
    global-quick-tap;
    flavor = "tap-preferred";
    bindings = <&kp>, <&ak_I_macro>;
};