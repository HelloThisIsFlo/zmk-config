                l_alpha_linwin {
                        label = "rEALITY¿"; // Windows layer, everything is upside down ⁉️
                        bindings = <
________      ________     ________     ________        ________                        ________    ________      ________    ________    ________
hml_LGUI_C    ________     hml_LCTRL_N  ________        ________                        ________    ________      hmr_LCTRL_E ________    &hmr LGUI M
________      ________     ________     ________        ________                        ________    ________      ________    ________    ________
                                ________    ________    &blt l_nav_linwin R      &blt l_nav_linwin SPACE     ________     ________
                        >;
                };