/*
Removed from keymap (for now ?)

&SlshStar
&DqtRbk
&HashDllr

*/

/*
Based on: Hands-Down Promethium
*/
                l_alpha {
                        label = "Reality?"; // The base layer ... ?
                        bindings = <
ak_X          ak_W         ak_M         ak_P           ak_K                             &SlashHash     dotcol        equalDash   &bk GRAVE    sqtDqt     
ak_C          ak_S         ak_N         ak_T           ak_B                             comsemi        ak_A          ak_E        ak_I         ak_H
ak_F          ak_G         ak_L         ak_D           ak_V                             &UnderStar     ak_U          ak_O        ak_Y         &bk J

                &mo l_num    tapStickyShiftHoldModsLayer     nav_akR              &blt l_numsym SPACE     &mo l_numsym     &togMacPc
                        >;
                };
