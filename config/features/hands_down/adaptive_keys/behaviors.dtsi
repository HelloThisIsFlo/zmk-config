aksl: aksl {
    compatible = "zmk,behavior-sticky-key";
    label = "flo,behavior-adaptive-key-sticky-layer";
    #binding-cells = <1>;
    release-after-ms = <my_ak_window>;
    bindings = <&mo>;
    // We are NOT using 'quick-release', that way the ak layer won't be deactivated until
    // the next &kp releases. Which means the next ak_layer will be activated immediately!
};

blt: blt {
    compatible = "zmk,behavior-hold-tap";
    label = "flo,behavior-buffered-layer-tap";
    #binding-cells = <2>;
    flavor = "tap-preferred";
    tapping-term-ms = <my_tapping_term_thumb>;
    bindings = <&mo>, <&bk>;
};

ZMK_MACRO(ak_R_macro, wait-ms = <0>; tap-ms = <0>; bindings = <&ak l_akR R>;)
blt_akR: blt_akR {
    compatible = "zmk,behavior-hold-tap";
    #binding-cells = <2>;
    flavor = "tap-preferred";
    tapping-term-ms = <my_tapping_term_thumb>;
    bindings = <&mo>, <&ak_R_macro>;
};
#define nav_akR  &blt_akR l_nav XXX


bksl: bksl {
    compatible = "zmk,behavior-hold-tap";
    label = "flo,behavior-buffered-key-sticky-layer";
    #binding-cells = <2>;
    flavor = "tap-preferred";
    tapping-term-ms = <my_tapping_term_thumb>;
    bindings = <&sl>, <&bk>;
};
