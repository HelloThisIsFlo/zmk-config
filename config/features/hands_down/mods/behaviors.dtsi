
skm: sticky_key_mod {
        compatible = "zmk,behavior-sticky-key";
        #binding-cells = <1>;
        bindings = <&kp>;
        // release-after-ms = <sticky_key_release_timeout_long>;
        release-after-ms = <1500>;
        // quick-release;
        // lazy;
        ignore-modifiers;
};

skms: sticky_key_mod_shift { 
        compatible = "zmk,behavior-sticky-key";
        #binding-cells = <1>;
        bindings = <&kp>;
        // release-after-ms = <sticky_key_release_timeout_long>;
        release-after-ms = <1500>;
        // quick-release;
        lazy; // This is important, so it doesn't affect the mouse clicks
        /delete-property/ ignore-modifiers;
};

slm: sticky_layer_mods {
        compatible = "zmk,behavior-sticky-key";
        #binding-cells = <1>;
        bindings = <&mo>;
        release-after-ms = <200>;
        // quick-release;
        // lazy;
        ignore-modifiers;
};


htm: hold_tap_mod {
    compatible = "zmk,behavior-hold-tap";
    #binding-cells = <2>;
    tapping-term-ms = <500>;
    flavor = "tap-preferred";
    bindings = <&bm>, <&skm>; // I tried to use 'modAndExtendTimeout' here, but didn't work. BEFORE CONTINUING => Create a clean commit!!
    hold-while-undecided;
    hold-while-undecided-linger;
};

htls: hold_tap_layer_sticky_shift {
    compatible = "zmk,behavior-hold-tap";
    #binding-cells = <2>;
    tapping-term-ms = <90>; // Tuned: Using https://genuine-sorbet-66e2f8.netlify.app   ACTUALLY, I could use the same as the linger key timeout. But for now, let's keep it separate.
    flavor = "tap-preferred"; // Tuned: When using shift, we may have situations where the next letter interrupts the shift. So, we want to make sure this doesn't trigger a hold.
    bindings = <&mo>, <&skms>;
    hold-while-undecided;
    hold-while-undecided-linger;
};
#define tapStickyShiftHoldModsLayer &htls l_mod LSHIFT



// Using balanced because the thumb won't be included in a rolling combo, and 'balanced' has the advantage to make the 'mo' layer feel more responsive. Also, the tap (sk) is the 'dangerous' action, as opposed to the home-row-mods (where tap is the 'safe' action).
bsklt: bsklt {
    compatible = "zmk,behavior-hold-tap";
    label = "flo,behavior-buffered-sticky-key-layer-tap";
    #binding-cells = <2>;
    flavor = "balanced";
    tapping-term-ms = <my_tapping_term_thumb>;
    bindings = <&mo>, <&bsk>;
};

/******************** Home Row Mods **********************/
// hm: homerow_mods { // use on either hand
//     compatible = "zmk,behavior-hold-tap";
//     label = "homerow_mods";
//     #binding-cells = <2>;
//     tapping-term-ms = <my_tapping_term_main>;
//     flavor = "tap-preferred";
//     bindings = <&bm>, <&bk>;
// };

// TODO: Use Bsk here (after doing supporting 'hold' in bk and bsk macros). Actually maybe it doesn't matter, I don't think the out of order issue would be a problem with modifiers (but why not, let's make it consistent with the rest)
hrmSk: hrmSk {
    compatible = "zmk,behavior-hold-tap";
    label = "homerow_mods_sk";
    #binding-cells = <2>;
    tapping-term-ms = <my_tapping_term_main>;
    flavor = "balanced";
    bindings = <&sk>, <&bk>;
};

hml: homerow_mods_left { // use on left hand to mod right
    compatible = "zmk,behavior-hold-tap";
    label = "homerow_mods_left";
    #binding-cells = <2>;
    tapping-term-ms = <my_tapping_term_main>;
    hold-trigger-key-positions = <THUMBS_R KEYS_R>;
    hold-trigger-on-release;
    flavor = "balanced";
    bindings = <&bm>, <&bk>;
};
ZMK_MACRO(ak_S_macro, wait-ms = <0>; tap-ms = <0>; bindings = <&ak l_akS S>;)
hml_S: hml_S {
    compatible = "zmk,behavior-hold-tap";
    label = "hml_S";
    #binding-cells = <2>;
    tapping-term-ms = <my_tapping_term_main>;
    hold-trigger-key-positions = <THUMBS_R KEYS_R>;
    hold-trigger-on-release;
    flavor = "balanced";
    bindings = <&bm>, <&ak_S_macro>;
};
ZMK_MACRO(ak_C_macro, wait-ms = <0>; tap-ms = <0>; bindings = <&ak l_akC C>;)
hml_C: hml_C {
    compatible = "zmk,behavior-hold-tap";
    label = "hml_C";
    #binding-cells = <2>;
    tapping-term-ms = <my_tapping_term_main>;
    hold-trigger-key-positions = <THUMBS_R KEYS_R>;
    hold-trigger-on-release;
    flavor = "balanced";
    bindings = <&bm>, <&ak_C_macro>;
};
ZMK_MACRO(ak_N_macro, wait-ms = <0>; tap-ms = <0>; bindings = <&ak l_akN N>;)
hml_N: hml_N {
    compatible = "zmk,behavior-hold-tap";
    label = "hml_N";
    #binding-cells = <2>;
    tapping-term-ms = <my_tapping_term_main>;
    hold-trigger-key-positions = <THUMBS_R KEYS_R>;
    hold-trigger-on-release;
    flavor = "balanced";
    bindings = <&bm>, <&ak_N_macro>;
};
ZMK_MACRO(ak_T_macro, wait-ms = <0>; tap-ms = <0>; bindings = <&ak l_akT T>;)
hml_T: hml_T {
    compatible = "zmk,behavior-hold-tap";
    label = "hml_T";
    #binding-cells = <2>;
    tapping-term-ms = <my_tapping_term_main>;
    hold-trigger-key-positions = <THUMBS_R KEYS_R>;
    hold-trigger-on-release;
    flavor = "balanced";
    bindings = <&bm>, <&ak_T_macro>;
};

hmr: homerow_mods_right { // use on right hand to mod left
    compatible = "zmk,behavior-hold-tap";
    label = "homerow_mods_right";
    #binding-cells = <2>;
    tapping-term-ms = <my_tapping_term_main>;
    hold-trigger-key-positions = <THUMBS_L KEYS_L>;
    hold-trigger-on-release;
    flavor = "balanced";
    bindings = <&bm>, <&bk>;
};
ZMK_MACRO(ak_A_macro, wait-ms = <0>; tap-ms = <0>; bindings = <&ak l_akA A>;)
hmr_A: hmr_A {
    compatible = "zmk,behavior-hold-tap";
    label = "hmr_A";
    #binding-cells = <2>;
    tapping-term-ms = <my_tapping_term_main>;
    hold-trigger-key-positions = <THUMBS_L KEYS_L>;
    hold-trigger-on-release;
    flavor = "balanced";
    bindings = <&bm>, <&ak_A_macro>;
};
ZMK_MACRO(ak_E_macro, wait-ms = <0>; tap-ms = <0>; bindings = <&ak l_akE E>;)
hmr_E: hmr_E {
    compatible = "zmk,behavior-hold-tap";
    label = "hmr_E";
    #binding-cells = <2>;
    tapping-term-ms = <my_tapping_term_main>;
    hold-trigger-key-positions = <THUMBS_L KEYS_L>;
    hold-trigger-on-release;
    flavor = "balanced";
    bindings = <&bm>, <&ak_E_macro>;
};
ZMK_MACRO(ak_M_macro, wait-ms = <0>; tap-ms = <0>; bindings = <&ak l_akM M>;)
hmr_M: hmr_M {
    compatible = "zmk,behavior-hold-tap";
    label = "hmr_M";
    #binding-cells = <2>;
    tapping-term-ms = <my_tapping_term_main>;
    hold-trigger-key-positions = <THUMBS_L KEYS_L>;
    hold-trigger-on-release;
    flavor = "balanced";
    bindings = <&bm>, <&ak_M_macro>;
};
// ZMK_MACRO(ak_I_macro, wait-ms = <0>; tap-ms = <0>; bindings = <&ak l_akI I>;)
// hmr_I: hmr_I {
//     compatible = "zmk,behavior-hold-tap";
//     label = "hmr_I";
//     #binding-cells = <2>;
//     tapping-term-ms = <my_tapping_term_main>;
//     hold-trigger-key-positions = <THUMBS_L KEYS_L>;
//     hold-trigger-on-release;
//     flavor = "balanced";
//     bindings = <&bm>, <&ak_I_macro>;
// };