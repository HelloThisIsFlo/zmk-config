moAndBuffer: moAndBuffer {
        // This macro is to guarantee that the mods layer is enabled juuuust long enough so that 
        // when the hold-tap decide on the hold behavior (and press the mod), the mods layer is STILL enabled.
        //
        // Essentiall, this guarantees: If I lift the thumb off the Action button AFTER I pressed the mods, even a microsecond after, everything will behave as expected:
        // - If I'm holding, it'll correctly hold
        // - If I'm tapping, it'll correctly trigger the sticky mod
        //
        compatible = "zmk,behavior-macro-one-param";
        #binding-cells = <1>;
        wait-ms = <0>;
        tap-ms = <0>; // Unused
        bindings =
                // <&macro_param_1to1>,
                <&macro_press &mo l_mod>, // TODO: Make this a parameter (?)

                <&macro_pause_for_release>,

                <&macro_wait_time action_mod_tapping_term>,
                <&macro_tap &none>,

                <&macro_release &mo l_mod>; // TODO: Make this a parameter (?)

                // <&macro_release &mo MACRO_PLACEHOLDER>;
};

// Make SHIFT disable the mods layer, so it doens't break the flow when needing to capitalize a letter.
// It works because shift is always the last modifier pressed (when rolling inwards)
shiftAndDisableModsLayer: shiftAndDisableModsLayer {
        compatible = "zmk,behavior-macro-one-param";
        #binding-cells = <1>;
        wait-ms = <0>;
        tap-ms = <TEMP_macro_tap_time>;
        bindings =
                <&macro_tap &skm LSHIFT>,
                <&macro_release &mo l_mod>;
};
