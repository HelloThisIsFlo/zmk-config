/*
Removed from keymap (for now ?)

&SlshStar
&DqtRbk
&HashDllr

*/

/*
Based on: Hands-Down Neu Vibranium B 
*/
                l_alpha {
                        label = "Reality?"; // The base layer ... ?
                        bindings = <

ak_X          ak_W         ak_M         ak_G            ak_V                          &MinusPlus      comsemi       sqtdqt      dotcol      &EqualAt      // Also try: &lk_DOT_SPACE DOT XXX

hml_LCTRL_S   hml_LALT_C   hml_LGUI_N   hml_LSHIFT_T    ak_K                          &SlashHash      hmr_LSHIFT_A  hmr_LGUI_E  &hmr LALT I &hmr LCTRL H

ak_B          ak_P         ak_L         ak_D            ak_J                          &UnderStar      ak_U          ak_O        ak_Y        ak_F

                     // &mo l_num   &bk LSHIFT          &hrmSk LSHIFT R        &hrmSk RSHIFT SPACE  &bskL RSHIFT  &togMacPc


                     // - Removed the number layer mo from the right hand, as I was never using it.
                     // - Also removed sticky shift from the right hand, I think left hand is enough, but we'll see.
                        &mo l_sym  &bsklt l_num LSHIFT  &blt l_nav R           &blt l_nav SPACE     &bsk RSHIFT     &togMacPc



                     // &mo l_num   &mo l_sym           &bksl l_nav R          &SpaceUnder  &skL RSHIFT  &togMacPc
                     // &mo l_sym  &bsklt l_num LSHIFT  &blt l_nav R           &SpaceUnder       &mo l_fn     &togMacPc
                        >;
                };
