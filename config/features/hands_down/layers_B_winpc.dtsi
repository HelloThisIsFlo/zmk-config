                l_winpc {
                        label = "rEALITY¿"; // Windows layer, everything is upside down ⁉️
                        bindings = <
________      ________     ________     ________        ________                      ________    ________      ________    ________    ________
hml_LGUI_S    ________     hml_LCTRL_N  ________        ________                      ________    ________      hmr_LCTRL_E ________    &hmr LGUI H
________      ________     ________     ________        ________                      ________    ________      ________    ________    ________
                                        ________   ________   ________      ________   ________   ________
                        >;
                };
